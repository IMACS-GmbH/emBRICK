// Definition for mcp7940x I2C based Real Time Clock
/dts-v1/;
/plugin/;

/ {
	compatible = "brcm,bcm2835";

	fragment@0 {
		target = <&i2c1>;
		__overlay__ {
			#address-cells = <1>;
			#size-cells = <0>;
			status = "okay";

			mcp7940x: mcp7940x@6f {
				compatible = "microchip,mcp7940x";
				reg = <0x6f>;
				status = "okay";
			};
		};
	};
  
  fragment@1 {
    target = <&i2c1>;
    __overlay__ {
        status = "okay";
    };
  };
  
	__overrides__ {
		mcp7940x = <0>,"+0";
		addr = <&mcp7940x>, "reg:0";
		wakeup-source = <&mcp7940x>,"wakeup-source?";
	};
};
